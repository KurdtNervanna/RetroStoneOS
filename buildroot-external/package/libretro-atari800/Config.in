## buildroot-external/package/libretro-atari800/Config.in
```kconfig
config BR2_PACKAGE_LIBRETRO_ATARI800
	bool "libretro-atari800"
	depends on BR2_PACKAGE_RSOS_LIBRETRO_ARCH_SUPPORTS # package/libretro-common.mk
	depends on !BR2_STATIC_LIBS # shared object loaded with dlopen()
	help
	  Atari800 7.0.0: Atari 400/800, XL/XE and XEGS computers and
	  the Atari 5200 console, built as a libretro core (GPL-2.0+).
	  The Altirra OS, 5200 OS and BASIC replacement ROMs are built
	  in, so every original ROM is optional. Has its own on-screen
	  keyboard.

	  Installs /usr/lib/libretro/atari800_libretro.so and
	  /usr/share/rsos/cores/atari800.ini. ROM folders: atari800,
	  atari5200.

	  https://github.com/libretro/libretro-atari800

comment "libretro-atari800 needs a toolchain w/ dynamic library"
	depends on BR2_PACKAGE_RSOS_LIBRETRO_ARCH_SUPPORTS
	depends on BR2_STATIC_LIBS
```

## buildroot-external/package/rsos-vc-games/Config.in
```kconfig
config BR2_PACKAGE_RSOS_VC_GAMES
	bool "rsos-vc-games"
	depends on !BR2_STATIC_LIBS # libretro cores, loaded with dlopen()
	help
	  The RetroStone VC games (8BCraft), the "RetroStone"
	  system at the start of the menu's carousel (docs/vc-games.md).

	  Each game is a libretro core built from the RetroStone VC
	  source (https://github.com/PaddleStroke/RetroStoneVC): the
	  SDK, the tools and the game code are MIT; the games' art,
	  music, sound, levels and design are CC BY-NC-SA 4.0. The game
	  is inside the core, there is no ROM.
	  Installs:
	  - /usr/lib/libretro/<game>_libretro.so and
	    /usr/share/rsos/cores/<game>.ini (no_content = true);
	  - /usr/share/rsos/games/retrostone/: one menu entry per game
	    ("Bomber Mole.bombermole", a stub file the host never
	    reads), gamelist.xml and media/images/ (title screens);
	  - /usr/share/rsos/licenses/retrostone-vc/.

	  "make legal-info" saves the source (the synced checkout).
	  The build needs python3 with Pillow and NumPy on the build host
	  (python3-pil, python3-numpy) for the games' asset step.

# Defined even when the package is disabled: the .mk sets the local SITE from
# it at parse time, and Buildroot parses every package .mk.
config BR2_PACKAGE_RSOS_VC_GAMES_SOURCE_DIR
	string "RetroStone VC checkout"
	default "$(BR2_EXTERNAL_RETROSTONE_PATH)/../../RetroStoneVC"
	help
	  The RetroStone VC repository (sdk/, games/, Makefile): by
	  default a checkout next to the RetroStoneOS one. CI checks
	  out the public PaddleStroke/RetroStoneVC and sets this path
	  (scripts/ci/build-board.sh, docs/ci.md). The build copies it
	  without build/, dist/, the art inbox and .git.

if BR2_PACKAGE_RSOS_VC_GAMES

config BR2_PACKAGE_RSOS_VC_GAMES_BOMBERMOLE
	bool "Bomber Mole"
	default y
	help
	  A mole who drops bombs to open the way, on three depths at
	  once, through four seasons. 1 player.

config BR2_PACKAGE_RSOS_VC_GAMES_LEADYSQUID
	bool "Leady Squid"
	default y
	help
	  A one-button "flap" game: a squid with too many lead weights
	  swims through the gaps of a sunken world. 1-4 players.

config BR2_PACKAGE_RSOS_VC_GAMES_DUCKPARADE
	bool "Duck Parade"
	default y
	help
	  Guide a family of ducks through ponds, roads and rivers. Up to
	  four parents cooperate to bring the ducklings home.

config BR2_PACKAGE_RSOS_VC_GAMES_BLUEBERRYTUMBLE
	bool "Blueberry Tumble"
	default y
	help
	  Roll a blueberry down a changing mountain landscape. Dodge
	  obstacles, collect dew and race with up to four players.

config BR2_PACKAGE_RSOS_VC_GAMES_BEAVERRUSH
	bool "Beaver Rush"
	default y
	help
	  Chop trees, dodge hazards and build your score. A fast arcade
	  challenge for one player or a race for up to four.

config BR2_PACKAGE_RSOS_VC_GAMES_PANCAKETOWER
	bool "Pancake Tower"
	default y
	help
	  Stack falling pancakes as precisely as possible, from the
	  kitchen to outer space. Build the tallest tower in solo play
	  or compete with up to four chefs.

config BR2_PACKAGE_RSOS_VC_GAMES_POGOMAMIE
	bool "Pogo Mamie"
	default y
	help
	  Bounce across the rooftops of Paris on a pogo stick. Avoid
	  aerial hazards, stomp pigeons and race with up to four
	  grannies.

config BR2_PACKAGE_RSOS_VC_GAMES_BISCUITBANDIT
	bool "Biscuit Bandit"
	default y
	help
	  A raccoon raids a bakery: catch the cookies falling from the
	  belts on your tray, but never the cups, and carry the stack to
	  the basket. 1-4 players.

config BR2_PACKAGE_RSOS_VC_GAMES_CRABCOCONUT
	bool "Crab Coconut"
	default y
	help
	  A crab on the beach bounces a coconut off its claws to break
	  the shells that rain from the sky. 1-4 players.

config BR2_PACKAGE_RSOS_VC_GAMES_FROGREACH
	bool "Frog Reach"
	default y
	help
	  Hold to stretch the frog's tongue just far enough to catch the
	  flies and cross the swamp from lily pad to lily pad. 1-4
	  players.

config BR2_PACKAGE_RSOS_VC_GAMES_HEDGEHOGHILLS
	bool "Hedgehog Hills"
	default y
	help
	  Curl up downhill, let go uphill: a hedgehog rolls and flies
	  over endless woodland hills. 1-4 players.

config BR2_PACKAGE_RSOS_VC_GAMES_MOLEMARBLES
	bool "Mole Marbles"
	default y
	help
	  A miner mole splits the bouncing gemstones of a cave with its
	  harpoon before they crush it. 1-4 players.

config BR2_PACKAGE_RSOS_VC_GAMES_MOTHAROUND
	bool "Moth Around"
	default y
	help
	  A moth circles a lantern at night: turn one way or the other
	  to slip through the closing rings. 1-4 players.

config BR2_PACKAGE_RSOS_VC_GAMES_MOUSEESPRESSO
	bool "Mouse Espresso"
	default y
	help
	  A mouse wearing an espresso machine flies through the cafe on
	  bursts of steam, collecting biscuits. 1-4 players.

config BR2_PACKAGE_RSOS_VC_GAMES_NUTTYBRANCH
	bool "Nutty Branch"
	default y
	help
	  A squirrel runs along an endless branch: steer, jump the gaps
	  and dodge the traps without sliding off its sides. 1-4
	  players.

config BR2_PACKAGE_RSOS_VC_GAMES_OTTERRAPIDS
	bool "Otter Rapids"
	default y
	help
	  An otter paddles down the river, catching golden fish and
	  dodging rocks, logs and the shadow of a hungry pike. 1-4
	  players.

config BR2_PACKAGE_RSOS_VC_GAMES_PENGUINSLALOM
	bool "Penguin Slalom"
	default y
	help
	  A penguin skis between the flags down an endless snowy slope,
	  catching fish and dodging polar bears. 1-4 players.

config BR2_PACKAGE_RSOS_VC_GAMES_RADISHRASCALS
	bool "Radish Rascals"
	default y
	help
	  A farmer shoos the rabbits from the vegetable beds with a
	  pitchfork, but must spare the hedgehogs. 1-4 players.

config BR2_PACKAGE_RSOS_VC_GAMES_RACCOONRECYCLER
	bool "Raccoon Recycler"
	default y
	help
	  A raccoon sorts the toys sliding down the chutes by kind or by
	  colour, while the rules keep changing. 1-4 players.

config BR2_PACKAGE_RSOS_VC_GAMES_SNAILSWITCH
	bool "Snail Switch"
	default y
	help
	  A snail flips above or below the vine to dodge thorns and
	  caterpillars and reach the fruits. 1-4 players.

config BR2_PACKAGE_RSOS_VC_GAMES_SPIDERSWING
	bool "Spider Swing"
	default y
	help
	  A spider swings from flower to flower on its silk and climbs
	  ever higher. 1-4 players.

config BR2_PACKAGE_RSOS_VC_GAMES_UNICORNHOP
	bool "Unicorn Hop"
	default y
	help
	  A unicorn hops from cloud to cloud, straight up through a sky
	  of drifting clouds, from morning to the aurora. 1-4 players.

config BR2_PACKAGE_RSOS_VC_GAMES_COSMOCORGI
	bool "Cosmo Corgi"
	default y
	help
	  A corgi astronaut flies its little rocket through space and
	  its star shots pop the wind-up robots: a horizontal shoot 'em
	  up. 1-4 players.

config BR2_PACKAGE_RSOS_VC_GAMES_FISHYFEAST
	bool "Fishy Feast"
	default y
	help
	  A little fish in a big pond eats plankton and smaller fish to
	  grow, and keeps away from the bigger ones. 1-4 players.

config BR2_PACKAGE_RSOS_VC_GAMES_HAMSTERHAVOC
	bool "Hamster Havoc"
	default y
	help
	  A hamster in a glass-dome spaceship defends its cheese moon
	  from waves of marching space mice. 1-4 players.

config BR2_PACKAGE_RSOS_VC_GAMES_CATERPILLARCRAWL
	bool "Caterpillar Crawl"
	default y
	help
	  A caterpillar crawls round a garden bed munching leaves, and
	  grows longer with each one; with friends, the last one still
	  crawling wins the round. 1-4 players.

config BR2_PACKAGE_RSOS_VC_GAMES_GECKOGOLF
	bool "Gecko Golf"
	default y
	help
	  A gecko plays golf on a course that never ends, seen from the
	  side, one hole per screen, on a budget of strokes. 1-4 players.

config BR2_PACKAGE_RSOS_VC_GAMES_GOPHERDIG
	bool "Gopher Dig"
	default y
	help
	  A gopher in a hard hat drills down a well of soft coloured
	  blocks, dodges the ones that fall and watches its air.
	  1-4 players.

config BR2_PACKAGE_RSOS_VC_GAMES_JELLYJAM
	bool "Jelly Jam"
	default y
	help
	  A falling-pairs puzzle duel in a jam kitchen: four jellies of
	  a colour melt, and chains rain grey jellies on the opponent.
	  1-4 players.

config BR2_PACKAGE_RSOS_VC_GAMES_KITTYKIBBLE
	bool "Kitty Kibble"
	default y
	help
	  A kitten eats every kibble of a room while four robot vacuums
	  try to tidy it up; a ball of yarn turns the tables.
	  1-4 players.

config BR2_PACKAGE_RSOS_VC_GAMES_LADYBUGLAPS
	bool "Ladybug Laps"
	default y
	help
	  Tiny ladybugs race round the garden table and the garden,
	  seen from above, against bots and friends. 1-4 players.

config BR2_PACKAGE_RSOS_VC_GAMES_LLAMADRAMA
	bool "Llama Drama"
	default y
	help
	  A llama in an Andean meadow spits at the hornets that buzz in
	  to sting its nose, from the morning to a starry night.
	  1-4 players.

config BR2_PACKAGE_RSOS_VC_GAMES_SEALSHOVE
	bool "Seal Shove"
	default y
	help
	  Four seals on a cracking ice floe shove each other into the
	  sea: the last one on the floe wins the round. 1-4 players.

config BR2_PACKAGE_RSOS_VC_GAMES_SNOWBALLSIEGE
	bool "Snowball Siege"
	default y
	help
	  A turn-by-turn snowball fight between snow forts, with the
	  wind changing every turn and every splat carving the snow.
	  1-4 players.

config BR2_PACKAGE_RSOS_VC_GAMES_GOATGORGE
	bool "Goat Gorge"
	default y
	help
	  A goat kid climbs a gorge one screen at a time: jump, slide
	  down the walls and dash once in the air, through five
	  chapters. 1 player.

config BR2_PACKAGE_RSOS_VC_GAMES_LEMURLEAP
	bool "Lemur Leap"
	default y
	help
	  A ring-tailed lemur bounces up a giant beanstalk into space,
	  steered left and right, stomping and shooting the pests.
	  1 player.

config BR2_PACKAGE_RSOS_VC_GAMES_PRICKLEPATCH
	bool "Prickle Patch"
	default y
	help
	  A hedgehog gardener keeps the vegetable patch from endless
	  pests: it only walks, its garden tools work by themselves.
	  1 player.

config BR2_PACKAGE_RSOS_VC_GAMES_PUFFINPLUNGE
	bool "Puffin Plunge"
	default y
	help
	  A puffin in bubble boots dives down an endless well, popping
	  the critters below with bubbles fired straight down.
	  1 player.

endif

comment "rsos-vc-games needs a toolchain w/ dynamic library"
	depends on BR2_STATIC_LIBS
```
