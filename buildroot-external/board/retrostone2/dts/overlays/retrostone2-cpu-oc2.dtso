// SPDX-License-Identifier: (GPL-2.0+ OR MIT)
/*
 * RetroStone2: CPU speed "Fastest" (Settings > Power > CPU speed): 1056 MHz
 * at 1.5 V, beyond the A20's tables (overclocking: not every chip takes it),
 * and the 1008 MHz step of cpu-oc1. The CPU supply (AXP209 DCDC2) may go to
 * 1.5 V. The thermal trip of sun7i-a20.dtsi (75 C) still slows it down.
 *
 * boot.cmd applies it as a trial (rsos_cpuspeed=2, rsos_cpuoc): a start that
 * does not end with an orderly shutdown falls back to the normal speed
 * (/usr/bin/rsos-cpuspeed).
 */

/dts-v1/;
/plugin/;

&cpu0 {
	operating-points =
		/* kHz	  uV */
		<1056000 1500000>,
		<1008000 1450000>,
		<960000	1400000>,
		<912000	1400000>,
		<864000	1300000>,
		<720000	1200000>,
		<528000	1100000>,
		<312000	1000000>,
		<144000	1000000>;
};

&cpu1 {
	operating-points =
		<1056000 1500000>,
		<1008000 1450000>,
		<960000	1400000>,
		<912000	1400000>,
		<864000	1300000>,
		<720000	1200000>,
		<528000	1100000>,
		<312000	1000000>,
		<144000	1000000>;
};

&reg_dcdc2 {
	regulator-max-microvolt = <1500000>;
};
